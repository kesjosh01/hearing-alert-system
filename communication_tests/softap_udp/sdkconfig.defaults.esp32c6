## firmware/common/ha_comm/Kconfig
```kconfig
menu "Hearing Alert communication"

    config HA_WIFI_SSID
        string "SoftAP SSID (S3 creates, C3 joins)"
        default "HearingAlert-Test"
        help
            Must be identical on both boards. Set a product-specific value in
            menuconfig; never commit a household Wi-Fi password.

    config HA_WIFI_PASSWORD
        string "SoftAP WPA2 password (8..63 chars)"
        default "hearing-test-2026"
        help
            Development credential reused from the TEST firmware. The firmware
            never prints it.

    config HA_WIFI_CHANNEL
        int "SoftAP channel (2.4 GHz)"
        range 1 13
        default 6

    config HA_UDP_PORT
        int "UDP port (both directions)"
        range 1024 65535
        default 4210

    config HA_AP_BEACON_INTERVAL_TU
        int "S3 beacon interval [TU, multiples of 100]"
        range 100 1000
        default 100
        help
            1 TU = 1024 us. ESP-IDF requires multiples of 100.

    config HA_AP_DTIM_PERIOD
        int "S3 DTIM period [beacons]"
        range 1 10
        default 3
        help
            C3 uses WIFI_PS_MIN_MODEM and wakes for every DTIM beacon.
            100 TU x 3 = 307.2 ms nominal receive interval, the closest supported
            value to the 300 ms target (2026-11-10 meeting). Exactly 300 ms is
            not configurable. The old TEST firmware used DTIM=1 (102.4 ms).

    config HA_HELLO_INTERVAL_MS
        int "C3 HELLO/heartbeat interval [ms]"
        default 10000

    config HA_PEER_STALE_MS
        int "S3: mark C3 stale after no HELLO for [ms]"
        default 35000

    config HA_DIAG_ALLOW_TEST_EVENT
        bool "DIAGNOSTIC: allow TEST(1) event id (enable on BOTH boards)"
        default n
        help
            Product builds reject TEST. Only for communication experiments.

    config HA_TIME_DELIVERY_BOUND_MS
        int "TIME_SYNC delivery-delay bound added to uncertainty [ms]"
        default 1000

    config HA_TIME_DRIFT_PPM
        int "C3 clock drift assumed for uncertainty growth [ppm]"
        default 1000
        help
            Conservative placeholder; not measured on the SuperMini.

    config HA_TIME_STALE_AFTER_S
        int "C3 clock considered stale after no sync for [s]"
        default 86400

endmenu
```

## firmware/receiver_c3/components/ha_receiver/Kconfig
```kconfig
menu "Hearing Alert C3 receiver"

    config HA_RX_ALERT_QUEUE_LEN
        int "Accepted-alert queue length (to the UI consumer)"
        range 2 32
        default 8
        help
            An EVENT is ACKed only if it fits in this queue AND a UI consumer is
            attached. Otherwise the S3 keeps retransmitting.

    config HA_RX_LIGHT_SLEEP_DELAY_MS
        int "Enable auto light-sleep after boot [ms]"
        default 15000
        help
            Grace window for USB flashing and boot logs (same as the TEST
            firmware). Wi-Fi MIN_MODEM is active from association.

    config HA_RX_PM_REPORT
        bool "Report SDK light-sleep counters to the S3 (PM_STATS)"
        default y
        help
            Sent together with HELLO every HELLO interval. These counters are
            the evidence of real sleep entry; requires CONFIG_PM_PROFILING.

    config HA_RX_DIAG_LOG_CONSUMER
        bool "DIAGNOSTIC: log-only alert consumer (no UI hardware)"
        default n
        help
            Attaches a consumer that only logs, so radio/ACK tests can run before
            the display/vibration code exists. Not an alert output; never enable
            in a product build.

endmenu
```

## firmware/receiver_c6/components/ha_receiver/Kconfig
```kconfig
menu "Hearing Alert C6 receiver (XIAO ESP32-C6)"

    choice HA_RX_ANTENNA
        prompt "Wi-Fi antenna (XIAO RF switch, GPIO14)"
        default HA_RX_ANTENNA_ONBOARD
        help
            The XIAO ESP32-C6 routes RF through a switch: GPIO3 LOW powers the
            switch control, GPIO14 LOW selects the on-board ceramic antenna,
            HIGH selects the U.FL connector (Seeed wiki). Both pins are driven
            before Wi-Fi starts and held through light-sleep. Do not use
            GPIO3/GPIO14 for anything else.

        config HA_RX_ANTENNA_ONBOARD
            bool "On-board ceramic antenna (GPIO14 LOW)"
        config HA_RX_ANTENNA_EXTERNAL
            bool "External U.FL antenna (GPIO14 HIGH)"
    endchoice

    config HA_RX_MAX_TX_POWER_QDBM
        int "Wi-Fi max TX power [0.25 dBm], 0 = SDK default"
        range 0 84
        default 0
        help
            0 leaves the ESP-IDF default. The former C3 SuperMini used 44
            (11 dBm) to work around that board's auth timeouts; that value was
            measured on the SuperMini only and is not carried over to the C6.

    config HA_RX_ALERT_QUEUE_LEN
        int "Accepted-alert queue length (to the UI consumer)"
        range 2 32
        default 8
        help
            An EVENT is ACKed only if it fits in this queue AND a UI consumer is
            attached. Otherwise the S3 keeps retransmitting.

    config HA_RX_ACK_ON_DISPLAY
        bool "Send ACK only after the alert's screen was sent to the LCD"
        default y
        help
            2026-11-17 contract: an accepted EVENT is NOT ACKed until the UI
            calls ha_receiver_alert_displayed() after the screen for it has
            been drawn. S3 retransmissions in between are recognised as
            duplicates and stay unanswered. If the screen never shows the
            alert (display fault), no ACK is sent and the S3 log shows the
            event as undelivered/EXPIRED. n = previous contract (ACK when the
            alert enters the UI queue).

    config HA_RX_LIGHT_SLEEP_DELAY_MS
        int "Enable auto light-sleep after boot [ms]"
        default 15000
        help
            Grace window for USB flashing and boot logs (same as the TEST
            firmware). Wi-Fi MIN_MODEM is active from association.

    config HA_RX_PM_REPORT
        bool "Report SDK light-sleep counters to the S3 (PM_STATS)"
        default y
        help
            Sent together with HELLO every HELLO interval. These counters are
            the evidence of real sleep entry; requires CONFIG_PM_PROFILING.

    config HA_RX_DIAG_LOG_CONSUMER
        bool "DIAGNOSTIC: log-only alert consumer (no UI hardware)"
        default n
        help
            Attaches a consumer that only logs, so radio/ACK tests can run before
            the display/vibration code exists. Not an alert output; never enable
            in a product build. With HA_RX_ACK_ON_DISPLAY it confirms each
            alert right after logging it (no screen). Do not enable together
            with the real UI (ha_ui).

endmenu
```

## firmware/receiver_c6/components/ha_ui/Kconfig
```kconfig
menu "Hearing Alert C6 UI (display / vibration / button)"

    comment "Pins: XIAO ESP32-C6 pin map of 2026-11-17 (-1 = not fitted)"

    config HA_UI_GPIO_MOTOR
        int "Vibration motor (NPN base via 1k) GPIO  [D2]"
        range -1 30
        default 2

    config HA_UI_MOTOR_ACTIVE_HIGH
        bool "Motor on = GPIO high"
        default y

    config HA_UI_GPIO_BUTTON
        int "Button S GPIO (pressed = LOW)  [D1]"
        range -1 30
        default 1

    config HA_UI_GPIO_BATT_ADC
        int "Battery divider ADC GPIO  [D0]"
        range -1 7
        default 0

    config HA_DISP_GPIO_SCK
        int "LCD SCL / SPI SCK GPIO  [D8]"
        range -1 30
        default 19

    config HA_DISP_GPIO_MOSI
        int "LCD SDA / SPI MOSI GPIO  [D10]"
        range -1 30
        default 18

    config HA_DISP_GPIO_CS
        int "LCD CS GPIO  [D4]"
        range -1 30
        default 22

    config HA_DISP_GPIO_DC
        int "LCD DC GPIO  [D5]"
        range -1 30
        default 23

    config HA_DISP_GPIO_RST
        int "LCD RES GPIO  [D7]"
        range -1 30
        default 17

    config HA_DISP_GPIO_BLK
        int "LCD BLK (backlight) GPIO  [D3]"
        range -1 30
        default 21

    config HA_DISP_SPI_HZ
        int "LCD SPI clock [Hz]"
        default 40000000

    config HA_DISP_MADCTL
        hex "GC9A01 MADCTL"
        default 0x08
        help
            0x08 = the breadboard demo orientation (Arduino_GFX rotation 0,
            BGR). 0x68 / 0xC8 / 0xA8 rotate by 90 / 180 / 270 degrees.

    config HA_DISP_INVERT
        bool "IPS colour inversion (INVON)"
        default y

    config HA_DISP_READBACK
        bool "Check the LCD answers (read status over SDA, 3-wire SPI)"
        default n
        help
            The pin map has no MISO, so without this an unplugged or frozen
            LCD cannot be detected (SPI writes succeed with nothing attached).
            When enabled, the panel status (RDDPM) is read over the SDA line
            before and after each alert draw; an unexpected answer triggers a
            re-init and counts as "not displayed" (no ACK). Reads run at 4 MHz
            (GC9A01 read cycle limit); SDA gets the internal pull-up, so a
            missing LCD reads 0xFF (bench 2026-11-17, XIAO C6 without LCD).
            BENCH-VERIFY WITH THE LCD:
            enable, flash, and check the boot log shows "RDDPM=0x9c" (or
            another value with bits 0x14 set and 0x60 clear). If it shows
            0x00/0xff or a shifted value with the LCD connected, this module
            does not support read-back this way: leave it off.

    comment "Display recovery (alert accepted but not on screen = not ACKed)"

    config HA_UI_RECOVER_AFTER_MS
        int "Re-initialise the LCD if an alert is not on screen after [ms]"
        default 3000

    config HA_UI_REBOOT_AFTER_MS
        int "Reboot the C6 if an alert is still not on screen after [ms]"
        default 6000
        help
            Must be larger than HA_UI_RECOVER_AFTER_MS. After the reboot the
            S3 resends the un-ACKed event (it keeps it until its TTL).

    config HA_UI_MAX_RECOVERY_REBOOTS
        int "Max consecutive watchdog reboots (then vibration-only mode)"
        range 0 10
        default 3
        help
            Counted across reboots; reset when an alert reaches the screen.
            Prevents an endless reboot loop with a dead LCD. In
            vibration-only mode alerts still vibrate, are not ACKed, and the
            LCD is retried every HA_UI_DISPLAY_RETRY_S.

    config HA_UI_DISPLAY_RETRY_S
        int "Retry a failed LCD every [s]"
        range 5 3600
        default 60

    comment "Alert behaviour (proposed values; settle after usability tests)"

    config HA_UI_FIRE_HOLD_MS
        int "Fire screen + vibration: back to watch after [ms] (0 = button only)"
        default 60000

    config HA_UI_DOORBELL_HOLD_MS
        int "Doorbell screen + vibration: back to watch after [ms] (0 = button only)"
        default 15000

    config HA_UI_HAPTIC_MAX_MS
        int "Vibration safety limit per pattern [ms] (0 = none)"
        default 120000
        help
            Stops any pattern after this long even if no button press or
            timeout happened (e.g. button broken).

    config HA_UI_SELFTEST
        bool "Short vibration at boot (self test)"
        default y

    config HA_UI_IDLE_BACKLIGHT_OFF_S
        int "Watch face: backlight off after [s] idle (0 = always on, like the demo)"
        default 0
        help
            The button turns it back on; alerts always turn it on.

    comment "Watch face"

    config HA_UI_UTC_OFFSET_MIN
        int "Local time offset from UTC [min] (KST = 540)"
        default 540

    config HA_UI_DEMO_BUILD_TIME
        bool "DEMO: start the clock from the firmware build time"
        default n
        help
            Like the demo's setCompileTime(): if no TIME_SYNC from the S3 has
            arrived, the clock runs from the build time (+ offset below).
            This is NOT a real time source. Without it the watch shows
            "--:--" until the S3 sends TIME_SYNC.

    config HA_UI_DEMO_BUILD_TIME_OFFSET_S
        int "DEMO: build-to-boot delay added to the build time [s]"
        depends on HA_UI_DEMO_BUILD_TIME
        default 20

    config HA_UI_BATT_DIVIDER_X100
        int "Battery divider ratio x100 (Vbat / Vadc; 0 = not measured)"
        default 0
        help
            0 shows "--%" (the divider resistors are not confirmed yet).
            200 = two equal resistors (Seeed XIAO reference circuit).

    config HA_UI_BATT_EMPTY_MV
        int "Battery 0 % at [mV]"
        default 3300

    config HA_UI_BATT_FULL_MV
        int "Battery 100 % at [mV]"
        default 4200

    config HA_UI_DEMO_BUTTON_CYCLE
        bool "DEMO: button cycles watch -> doorbell -> fire -> watch (no radio)"
        default n
        help
            Reproduces the breadboard demo without the S3. Screens shown this
            way are local only and send no ACK.

endmenu
```

## firmware/transmitter_s3/components/ha_sender/Kconfig
```kconfig
menu "Hearing Alert S3 sender"

    config HA_TX_QUEUE_CAPACITY
        int "Event queue capacity (including the in-flight event)"
        range 2 32
        default 8
        help
            Design default. When full: evict the oldest queued event, but
            FIRE_ALARM is only evicted by another FIRE_ALARM; the in-flight
            event is never evicted. A DOORBELL is rejected (QUEUE_FULL) if only
            FIRE_ALARM entries remain.

    config HA_TX_ACK_WAIT_MS
        int "ACK wait per attempt [ms]"
        default 700
        help
            Design default derived from the 307.2 ms DTIM receive interval
            (one missed beacon -> ~614 ms) plus processing. Not measured.

    config HA_TX_ATTEMPTS_PER_BURST
        int "Attempts per retry burst"
        range 1 20
        default 4

    config HA_TX_BACKOFF_MIN_MS
        int "Pause after a failed burst [ms] (doubles each time)"
        default 2000

    config HA_TX_BACKOFF_MAX_MS
        int "Maximum pause between bursts [ms]"
        default 16000

    config HA_TTL_FIRE_ALARM_S
        int "FIRE_ALARM lifetime in queue [s] (0 = no expiry)"
        default 600
        help
            Development default selected 2026-11-15 (10 min).

    config HA_TTL_DOORBELL_S
        int "DOORBELL lifetime in queue [s] (0 = no expiry)"
        default 120
        help
            Development default selected 2026-11-15 (2 min).

    config HA_TX_FIRE_FIRST
        bool "Send queued FIRE_ALARM before older DOORBELL (no preemption)"
        default n
        help
            Optional. Default is plain FIFO. The in-flight event is never
            preempted; seq is assigned at send time so C3 duplicate detection
            stays valid with either order.

    config HA_TIME_SYNC_TX
        bool "Send TIME_SYNC (v2) when a time provider is registered"
        default n
        help
            Optional extension. No SNTP / home Wi-Fi client is included; the
            application must register ha_sender_set_time_provider().

    config HA_TIME_SYNC_PERIOD_S
        int "TIME_SYNC period [s]"
        depends on HA_TIME_SYNC_TX
        default 600

    config HA_DIAG_INJECT_EVENTS
        bool "DIAGNOSTIC: inject synthetic FIRE/DOORBELL events periodically"
        default n
        help
            For radio-path tests without ML. Never enable in a product build and
            never report its results as sound detection.

    config HA_DIAG_INJECT_PERIOD_MS
        int "DIAGNOSTIC injection period [ms]"
        depends on HA_DIAG_INJECT_EVENTS
        default 5000

endmenu
```
